## core/Kconfig.projbuild
```kconfig
menu "NetStrike32 Configuration"

    menu "Management Access Point"

        config CONSOLE_SSID
            string "Management AP SSID"
            default "NetStrike32"
            help
                SSID of the management access point used for web interface access.

        config CONSOLE_KEY
            string "Management AP Password"
            default "Strike32!"
            help
                WPA2 password for the management access point. Minimum 8 characters.

        config CONSOLE_CLIENT_LIMIT
            int "Max simultaneous connections"
            default 1
            range 1 4
            help
                Maximum number of clients allowed to connect to the management AP.

    endmenu

    menu "Network Scanner"

        config RADAR_MAX_TARGETS
            int "Maximum APs to scan"
            default 20
            range 5 50
            help
                Maximum number of access points stored in a single scan pass.

    endmenu

endmenu
```

## sdkconfig.defaults
```kconfig
CONFIG_ESPTOOLPY_FLASHSIZE_4MB=y
CONFIG_PARTITION_TABLE_SINGLE_APP=y
CONFIG_ESP_MAIN_TASK_STACK_SIZE=8192
CONFIG_FREERTOS_HZ=1000
CONFIG_CONSOLE_SSID="NetStrike32"
CONFIG_CONSOLE_KEY="Strike32!"
CONFIG_CONSOLE_CLIENT_LIMIT=1
CONFIG_RADAR_MAX_TARGETS=20
CONFIG_ESP_WIFI_SOFTAP_SUPPORT=y
CONFIG_ESP_WIFI_STATIC_RX_BUFFER_NUM=10
CONFIG_ESP_WIFI_DYNAMIC_RX_BUFFER_NUM=32
CONFIG_ESP_WIFI_TX_BUFFER_TYPE=1
CONFIG_LWIP_MAX_SOCKETS=16
CONFIG_HTTPD_MAX_REQ_HDR_LEN=1024
CONFIG_HTTPD_MAX_URI_LEN=512
```
